## components/usb_host_uvc/Kconfig
```kconfig
menu "USB HOST UVC"

    config UVC_PRINTF_CONFIGURATION_DESCRIPTOR
        bool "Print UVC Configuration Descriptor"
        default n
        help
            Print UVC Configuration Descriptor to console.

    config UVC_INTERVAL_ARRAY_SIZE
        int "Size of the interval array in uvc_host_frame_info_t"
        default 3
        help
            This option sets the size of the interval array in the `uvc_host_frame_info_t` structure.
            Increase this value if you need to support more discrete frame intervals.

    config UVC_CHECK_PAYLOAD_HEADER_EOH
        bool "Check EOH bit in payload header"
        default y
        help
            "If EOH is set in the header, this is the last header group in the packet"

    config UVC_ISOC_DIAG
        bool "Enable UVC isochronous stream diagnostics"
        default n
        help
            Enables per-second isochronous stream counters and bounded anomaly
            samples in the UVC ISOC path. Keep this disabled for production
            builds unless diagnosing frame assembly or transport problems.

    config UVC_ISOC_DIAG_SAMPLE_LIMIT
        int "UVC isochronous diagnostic sample limit"
        depends on UVC_ISOC_DIAG
        default 32
        range 0 1024
        help
            Maximum number of anomaly samples to print per boot when
            UVC_ISOC_DIAG is enabled.
endmenu
```
